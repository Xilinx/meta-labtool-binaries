## conf/layer.conf
```bitbake
# We have a conf and classes directory, add to BBPATH
BBPATH .= ":${LAYERDIR}"

# We have recipes-* directories, add to BBFILES
BBFILES += "${LAYERDIR}/recipes-*/*/*.bb \
            ${LAYERDIR}/recipes-*/*/*.bbappend"

BBFILE_COLLECTIONS += "meta-labtool-binaries"
BBFILE_PATTERN_meta-labtool-binaries = "^${LAYERDIR}/"
BBFILE_PRIORITY_meta-labtool-binaries = "6"

LAYERSERIES_COMPAT_meta-labtool-binaries = "langdale"
```
